## boards/shields/pie40/Kconfig.defconfig
```kconfig
# Copyright (c) 2020 The ZMK Contributors
# SPDX-License-Identifier: MIT

if SHIELD_PIE40

config ZMK_KEYBOARD_NAME
    default "PIE40"

endif
```

## boards/shields/pie40/Kconfig.shield
```kconfig
# Copyright (c) 2020 The ZMK Contributors
# SPDX-License-Identifier: MIT

config SHIELD_PIE40
    def_bool $(shields_list_contains,pie40)
```
